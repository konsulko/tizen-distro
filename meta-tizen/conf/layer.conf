## meta-tizen/conf/layer.conf
```bitbake
# We have a conf and classes directory, add to BBPATH
BBPATH .= ":${LAYERDIR}"

# We have a packages directory, add to BBFILES
BBFILES := "${BBFILES} \
            ${LAYERDIR}/recipes-*/*/*.bb \
            ${LAYERDIR}/recipes-*/*/*.bbappend"

BBFILE_COLLECTIONS += "tizen-layer"
BBFILE_PATTERN_tizen-layer := "^${LAYERDIR}/"
BBFILE_PRIORITY_tizen-layer = "7"

PACKAGE_CLASSES = "package_rpm"

INHERIT_DISTRO = "devshell sstate license"

INHERIT += "metatizen"

#262144=256(Mo)*1024
IMAGE_ROOTFS_SIZE_ext3 = "262144"

# Crosswalk third-party "angle" doesn't build with gcc 4.9
# https://bugs.tizen.org/jira/browse/BTY-38
GCCVERSION = "4.8%"

DISTRO_FEATURES_append = " pam "
DISTRO_FEATURES_remove = " x11"
DISTRO_FEATURES_append = " wayland"
DISTRO_FEATURES_append = " ld-is-gold "

# Use weston from Tizen since it contains Tizen specific patches
WESTONSTARTUP ??= "weston-common"

DEPENDS_remove =  "rpmresolve-native"
DEPENDS_rpm-lang-all = "rpm-native"
DEPENDS_rpminst = "rpm-native"
DEPENDS_rpm-libs = "rpm-native"

DISTRO_FEATURES_append = " systemd"
VIRTUAL-RUNTIME_init_manager = "systemd"

PREFERRED_PROVIDER_python-dbus = "dbus-python"
PREFERRED_PROVIDER_jpeg = "libjpeg-turbo"
PREFERRED_PROVIDER_jpeg-native = "libjpeg-turbo-native"
PREFERRED_PROVIDER_libtdb = "tdb"
PREFERRED_PROVIDER_make-native = "make-native"
PREFERRED_PROVIDER_python-setuptools = "python-setuptools"
PREFERRED_PROVIDER_rpmbuild = "rpm-native"
PREFERRED_PROVIDER_libpam = "pam"
PREFERRED_PROVIDER_pciutils-ids = "pciutils"

PREFERRED_VERSION_pulseaudio = "git"
PREFERRED_VERSION_libav = "git"
PREFERRED_VERSION_linux-yocto ?= "3.14%"
PREFERRED_VERSION_weston = "git"
PREFERRED_VERSION_pam = "git"
PREFERRED_VERSION_libjpeg-turbo = "8d%"
PREFERRED_VERSION_libjpeg-turbo-native = "8d%"

LICENSE_FLAGS_WHITELIST += "commercial"

IMAGECONFIG ??= "config-tizen-common"

FILESYSTEM_PERMS_TABLES = "tizen-fs-perms.txt"
```

## meta-tizen/meta-open-ivi/conf/distro/open-ivi.conf
```bitbake
require conf/distro/tizen.conf
DISTRO = "open-ivi"

# Open IVI configurations
IMAGECONFIG ?= "config-open-ivi"

DISTRO_FEATURES += "open-ivi"
```

## meta-tizen/meta-tizen-adaptation/meta-oe/conf/layer.conf
```bitbake
# We have a conf and classes directory, add to BBPATH
BBPATH .= ":${LAYERDIR}"

# We have a packages directory, add to BBFILES
BBFILES := "${BBFILES} \
            ${LAYERDIR}/recipes-*/*/*.bb \
            ${LAYERDIR}/recipes-*/*/*.bbappend"

BBFILE_COLLECTIONS += "meta-tizen-adaptation-meta-oe"
BBFILE_PATTERN_meta-tizen-adaptation-meta-oe := "^${LAYERDIR}/"
BBFILE_PRIORITY_meta-tizen-adaptation-meta-oe = "8"
```

## meta-tizen/meta-tizen-adaptation/meta/conf/layer.conf
```bitbake
# We have a conf and classes directory, add to BBPATH
BBPATH .= ":${LAYERDIR}"

# We have a packages directory, add to BBFILES
BBFILES := "${BBFILES} \
            ${LAYERDIR}/recipes-*/*/*.bb \
            ${LAYERDIR}/recipes-*/*/*.bbappend"

BBFILE_COLLECTIONS += "meta-tizen-adaptation-meta"
BBFILE_PATTERN_meta-tizen-adaptation-meta := "^${LAYERDIR}/"
BBFILE_PRIORITY_meta-tizen-adaptation-meta = "8"
```

## meta-tizen/meta-tizen-adaptation/meta/recipes-kernel/linux/linux-yocto/arm/defconfig
```kconfig
# CONFIG_LOCALVERSION_AUTO is not set
CONFIG_DEFAULT_HOSTNAME="common_box"
CONFIG_SYSVIPC=y
CONFIG_POSIX_MQUEUE=y
CONFIG_FHANDLE=y
CONFIG_HIGH_RES_TIMERS=y
CONFIG_IKCONFIG=y
CONFIG_IKCONFIG_PROC=y
CONFIG_CGROUP_FREEZER=y
CONFIG_CGROUP_DEVICE=y
CONFIG_CPUSETS=y
CONFIG_CGROUP_CPUACCT=y
CONFIG_RESOURCE_COUNTERS=y
CONFIG_MEMCG=y
CONFIG_MEMCG_SWAP=y
# CONFIG_MEMCG_SWAP_ENABLED is not set
CONFIG_MEMCG_KMEM=y
CONFIG_CGROUP_PERF=y
CONFIG_CFS_BANDWIDTH=y
CONFIG_RT_GROUP_SCHED=y
CONFIG_BLK_CGROUP=y
CONFIG_NAMESPACES=y
CONFIG_USER_NS=y
CONFIG_SCHED_AUTOGROUP=y
CONFIG_BLK_DEV_INITRD=y
CONFIG_RD_BZIP2=y
CONFIG_RD_LZMA=y
CONFIG_RD_XZ=y
CONFIG_RD_LZO=y
CONFIG_RD_LZ4=y
CONFIG_CC_OPTIMIZE_FOR_SIZE=y
CONFIG_EMBEDDED=y
# CONFIG_SLUB_DEBUG is not set
CONFIG_PROFILING=y
CONFIG_OPROFILE=y
CONFIG_MODULES=y
CONFIG_MODULE_UNLOAD=y
CONFIG_MODULE_FORCE_UNLOAD=y
CONFIG_BLK_DEV_THROTTLING=y
CONFIG_PARTITION_ADVANCED=y
CONFIG_BSD_DISKLABEL=y
CONFIG_MINIX_SUBPARTITION=y
CONFIG_SOLARIS_X86_PARTITION=y
CONFIG_UNIXWARE_DISKLABEL=y
CONFIG_LDM_PARTITION=y
CONFIG_SGI_PARTITION=y
CONFIG_SUN_PARTITION=y
CONFIG_KARMA_PARTITION=y
CONFIG_IOSCHED_DEADLINE=m
CONFIG_CFQ_GROUP_IOSCHED=y
CONFIG_DEFAULT_NOOP=y
CONFIG_ARCH_VEXPRESS=y
CONFIG_ARCH_VEXPRESS_CA9X4=y
CONFIG_ARCH_VEXPRESS_DCSCB=y
CONFIG_ARCH_VEXPRESS_TC2_PM=y
# CONFIG_SWP_EMULATE is not set
CONFIG_SMP=y
CONFIG_SCHED_SMT=y
CONFIG_HAVE_ARM_ARCH_TIMER=y
CONFIG_MCPM=y
CONFIG_VMSPLIT_2G=y
CONFIG_NR_CPUS=8
CONFIG_ARM_PSCI=y
CONFIG_HZ_1000=y
CONFIG_AEABI=y
CONFIG_CMA=y
CONFIG_SECCOMP=y
CONFIG_ZBOOT_ROM_TEXT=0x0
CONFIG_ZBOOT_ROM_BSS=0x0
CONFIG_CMDLINE="console=ttyAMA0"
CONFIG_CPU_IDLE=y
CONFIG_CPU_IDLE_MULTIPLE_DRIVERS=y
CONFIG_VFP=y
CONFIG_NEON=y
# CONFIG_CORE_DUMP_DEFAULT_ELF_HEADERS is not set
CONFIG_NET=y
CONFIG_PACKET=y
CONFIG_UNIX=y
CONFIG_INET=y
CONFIG_IP_PNP=y
CONFIG_IP_PNP_DHCP=y
CONFIG_IP_PNP_BOOTP=y
# CONFIG_INET_LRO is not set
CONFIG_BT=m
# CONFIG_WIRELESS is not set
CONFIG_NET_9P=y
CONFIG_NET_9P_VIRTIO=y
CONFIG_DEVTMPFS=y
# CONFIG_FW_LOADER_USER_HELPER is not set
CONFIG_MTD=y
CONFIG_MTD_CMDLINE_PARTS=y
CONFIG_MTD_BLOCK=y
CONFIG_MTD_CFI=y
CONFIG_MTD_CFI_INTELEXT=y
CONFIG_MTD_CFI_AMDSTD=y
CONFIG_MTD_PHYSMAP=y
CONFIG_MTD_PHYSMAP_OF=y
CONFIG_MTD_PLATRAM=y
CONFIG_MTD_UBI=y
CONFIG_PROC_DEVICETREE=y
CONFIG_VIRTIO_BLK=y
# CONFIG_SCSI_PROC_FS is not set
CONFIG_BLK_DEV_SD=y
CONFIG_SCSI_VIRTIO=y
CONFIG_ATA=y
# CONFIG_SATA_PMP is not set
CONFIG_NETDEVICES=y
CONFIG_VIRTIO_NET=y
CONFIG_SMC91X=y
CONFIG_SMSC911X=y
# CONFIG_WLAN is not set
CONFIG_INPUT_EVDEV=y
# CONFIG_SERIO_SERPORT is not set
CONFIG_SERIO_AMBAKMI=y
CONFIG_LEGACY_PTY_COUNT=16
CONFIG_SERIAL_AMBA_PL011=y
CONFIG_SERIAL_AMBA_PL011_CONSOLE=y
CONFIG_VIRTIO_CONSOLE=y
CONFIG_HW_RANDOM=y
CONFIG_HW_RANDOM_VIRTIO=y
CONFIG_I2C=y
CONFIG_I2C_VERSATILE=y
CONFIG_SENSORS_VEXPRESS=y
CONFIG_REGULATOR=y
CONFIG_REGULATOR_VEXPRESS=y
CONFIG_FB=y
CONFIG_FB_ARMCLCD=y
CONFIG_FRAMEBUFFER_CONSOLE=y
CONFIG_LOGO=y
# CONFIG_LOGO_LINUX_MONO is not set
# CONFIG_LOGO_LINUX_VGA16 is not set
CONFIG_SOUND=y
CONFIG_SND=y
CONFIG_SND_MIXER_OSS=y
CONFIG_SND_PCM_OSS=y
# CONFIG_SND_DRIVERS is not set
CONFIG_SND_ARMAACI=y
CONFIG_HID_DRAGONRISE=y
CONFIG_HID_GYRATION=y
CONFIG_HID_TWINHAN=y
CONFIG_HID_NTRIG=y
CONFIG_HID_PANTHERLORD=y
CONFIG_HID_PETALYNX=y
CONFIG_HID_SAMSUNG=y
CONFIG_HID_SONY=y
CONFIG_HID_SUNPLUS=y
CONFIG_HID_GREENASIA=y
CONFIG_HID_SMARTJOYPLUS=y
CONFIG_HID_TOPSEED=y
CONFIG_HID_THRUSTMASTER=y
CONFIG_HID_ZEROPLUS=y
CONFIG_USB=y
CONFIG_USB_ANNOUNCE_NEW_DEVICES=y
CONFIG_USB_MON=y
CONFIG_USB_ISP1760_HCD=y
CONFIG_USB_STORAGE=y
CONFIG_MMC=y
CONFIG_MMC_ARMMMCI=y
CONFIG_NEW_LEDS=y
CONFIG_LEDS_CLASS=y
CONFIG_LEDS_GPIO=y
CONFIG_LEDS_TRIGGERS=y
CONFIG_LEDS_TRIGGER_HEARTBEAT=y
CONFIG_LEDS_TRIGGER_CPU=y
CONFIG_RTC_CLASS=y
CONFIG_RTC_DRV_PL031=y
CONFIG_VIRTIO_BALLOON=y
CONFIG_VIRTIO_MMIO=y
CONFIG_VIRTIO_MMIO_CMDLINE_DEVICES=y
CONFIG_EXT2_FS=y
CONFIG_EXT3_FS=y
# CONFIG_EXT3_DEFAULTS_TO_ORDERED is not set
# CONFIG_EXT3_FS_XATTR is not set
CONFIG_EXT4_FS=y
CONFIG_EXT4_FS_POSIX_ACL=y
CONFIG_AUTOFS4_FS=y
CONFIG_MSDOS_FS=y
CONFIG_VFAT_FS=y
CONFIG_TMPFS=y
CONFIG_TMPFS_POSIX_ACL=y
CONFIG_JFFS2_FS=y
CONFIG_UBIFS_FS=y
CONFIG_CRAMFS=y
CONFIG_SQUASHFS=y
CONFIG_SQUASHFS_LZO=y
CONFIG_NFS_FS=y
CONFIG_ROOT_NFS=y
CONFIG_9P_FS=y
CONFIG_NLS_CODEPAGE_437=y
CONFIG_NLS_ISO8859_1=y
CONFIG_DEBUG_INFO=y
CONFIG_DEBUG_FS=y
CONFIG_MAGIC_SYSRQ=y
CONFIG_DETECT_HUNG_TASK=y
# CONFIG_SCHED_DEBUG is not set
CONFIG_SCHEDSTATS=y
CONFIG_DEBUG_USER=y
CONFIG_SECURITY=y
CONFIG_SECURITY_SMACK=y
# CONFIG_CRYPTO_ANSI_CPRNG is not set
# CONFIG_CRYPTO_HW is not set
```

## meta-tizen/meta-tizen-common-base/conf/distro/tizen.conf
```bitbake
DISTRO_NAME = "Tizen"
DISTRO_VERSION = "3.0"

LOCALCONF_VERSION = "1"
LAYER_CONF_VERSION ?= "5"

TIZEN_DEFAULT_DISTRO_FEATURES = "largefile ptest multiarch"
TIZEN_DEFAULT_DISTRO_FEATURES = "ld-is-gold pam wayland systemd opengl"
TIZEN_DEFAULT_EXTRA_RRECOMMENDS = ""
DISTRO_FEATURES_DEFAULT_remove = "x11"
# Really avoid legacy sysvinit. It would get added both via DISTRO_FEATURES_DEFAULT
# and features_backfill() in utils.py.
DISTRO_FEATURES_DEFAULT_remove = "sysvinit"
DISTRO_FEATURES_BACKFILL_CONSIDERED += "sysvinit"
DISTRO_FEATURES ?= "${DISTRO_FEATURES_DEFAULT} ${DISTRO_FEATURES_LIBC} ${TIZEN_DEFAULT_DISTRO_FEATURES}" 

VIRTUAL-RUNTIME_init_manager = "systemd"

PACKAGE_CLASSES ?= "package_rpm"
INHERIT_DISTRO_remove = "debian"
INHERIT_TIZEN = "metatizen"
INHERIT ?= "${PACKAGE_CLASSES} ${USER_CLASSES} ${INHERIT_DISTRO} ${INHERIT_BLACKLIST} ${INHERIT_TIZEN}"

DEPENDS_rpm-lang-all = "rpm-native"
DEPENDS_rpminst = "rpm-native"
DEPENDS_rpm-libs = "rpm-native"

#262144=256(Mo)*1024
IMAGE_ROOTFS_SIZE_ext3 = "262144"

# Use weston from Tizen since it contains Tizen specific patches
WESTONSTARTUP ??= "weston-common"
IMAGECONFIG ??= "config-tizen-common"
TLMCONFIG ??= "tlm-config-common"


PREFERRED_PROVIDER_python-dbus = "dbus-python"
PREFERRED_PROVIDER_jpeg = "libjpeg-turbo"
PREFERRED_PROVIDER_jpeg-native = "libjpeg-turbo-native"
PREFERRED_PROVIDER_libtdb = "tdb"
PREFERRED_PROVIDER_make-native = "make-native"
PREFERRED_PROVIDER_python-setuptools = "python-setuptools"
PREFERRED_PROVIDER_rpmbuild = "rpm-native"
PREFERRED_PROVIDER_libpam = "pam"
PREFERRED_PROVIDER_pciutils-ids = "pciutils"

PREFERRED_VERSION_linux-yocto ?= "3.14%"
PREFERRED_VERSION_elfutils ?= "1.60"

LICENSE_FLAGS_WHITELIST += "commercial"

SYS_CTLR_PROVIDER = ""

SYSTEMD_DEFAULT_TARGET="graphical.target"


# Fallback Smack .manifest file for packages which don't have any other
# .manifest file settings. Override with either MANIFESTSFILES (if
# .manifest part of the source) or other SRC_URI entries.
#
# In SRC_URI, any file ending in .manifest is considered a Tizen Smack
# manifest file. The first one without a 'pkg' parameter is the
# default for all packages. If a pkg parameter is given and non-empty,
# its parameter is treated as a comma separated list of the names of
# those packages for which this manifest file is used. The
# file://tizen-default.manifest is set for all recipes automatically,
# so most recipes don't need to be modified.
#
# A .manifest.in file may contain @<word>@ placeholders (@bindir@,
# @TZ_USER_NAME@). Those get replaced before passing the file to rpm,
# see metatizen.bbclass for details.
#
# The extra space at the end is a workaround for recipes which lack a
# space in their own _append.
SRC_URI_append = " file://${META_TIZEN_COMMON_BASE}/conf/distro/tizen-default.manifest "
```

## meta-tizen/meta-tizen-common-base/conf/layer.conf
```bitbake
DISTRO = "tizen"

# We have a conf and classes directory, add to BBPATH
BBPATH .= ":${LAYERDIR}"

# Needed to find tizen-default.manifest.
META_TIZEN_COMMON_BASE := "${LAYERDIR}"

# We have a packages directory, add to BBFILES
BBFILES := "${BBFILES} \
            ${LAYERDIR}/recipes-*/*/*.bb \
            ${LAYERDIR}/recipes-*/*/*.bbappend"

BBFILE_COLLECTIONS += "meta-tizen-common-base"
BBFILE_PATTERN_meta-tizen-common-base := "^${LAYERDIR}/"
BBFILE_PRIORITY_meta-tizen-common-base = "8"
```

## meta-tizen/meta-tizen-common-base/conf/local.conf.sample
```bitbake
CONF_VERSION="1"

#
# Machine Selection
#
# You need to select a specific machine to target the build with. There are a selection
# of emulated machines available which can boot and run in the QEMU emulator:
#
#MACHINE ?= "qemux86"
#MACHINE ?= "qemux86-64"
#MACHINE ?= "genericx86"
#
# This sets the default machine to be qemux86 if no other machine is selected:
MACHINE ??= "genericx86-64"

#
# Parallelism Options
#
# These two options control how much parallelism BitBake should use. The first
# option determines how many tasks bitbake should run in parallel:
#
#BB_NUMBER_THREADS ?= "4"
#
# Default to setting automatically based on cpu count
#BB_NUMBER_THREADS ?= "${@oe.utils.cpu_count()}"
#
# The second option controls how many processes make should run in parallel when
# running compile tasks:
#
#PARALLEL_MAKE ?= "-j 4"
#
# Default to setting automatically based on cpu count
#PARALLEL_MAKE ?= "-j ${@oe.utils.cpu_count()}"
#
# For a quad-core machine, BB_NUMBER_THREADS = "4", PARALLEL_MAKE = "-j 4" would
# be appropriate for example.
#

#
# The following are used to control options related to debugging.
#
# Uncomment this to change the optimization to make debugging easer, at the 
# possible cost of performance.
# DEBUG_BUILD = "1"
#

#
# Disk space monitor, take action when the disk space or the amount of
# inode is running low, it is enabled when BB_DISKMON_DIRS is set.
#
# Set the directory for the monitor, the format is:
# "action,directory,minimum_space,minimum_free_inode"
#
# The "action" must be set and should be one of:
# ABORT: Immediately abort
# STOPTASKS: The new tasks can't be executed any more, will stop the build
#           when the running tasks have been done.
# WARN: show warnings (see BB_DISKMON_WARNINTERVAL for more information)
#
# The "directory" must be set, any directory is OK.
#
# Either "minimum_space" or "minimum_free_inode" (or both of them)
# should be set, otherwise the monitor would not be enabled,
# the unit can be G, M, K or none, but do NOT use GB, MB or KB
# (B is not needed).
#BB_DISKMON_DIRS = "STOPTASKS,${TMPDIR},1G,100K WARN,${SSTATE_DIR},1G,100K"
#
# Set disk space and inode interval (only works when the action is "WARN",
# the unit can be G, M, or K, but do NOT use the GB, MB or KB
# (B is not needed), the format is:
# "disk_space_interval,disk_inode_interval", the default value is
# "50M,5K" which means that it would warn when the free space is
# lower than the minimum space(or inode), and would repeat the warning
# when the disk space reduces 50M (or the amount of inode reduces 5k).
#BB_DISKMON_WARNINTERVAL = "50M,5K"
#
```

## meta-tizen/meta-tizen-common-demo/conf/layer.conf
```bitbake
# We have a conf and classes directory, add to BBPATH
BBPATH .= ":${LAYERDIR}"

# We have a packages directory, add to BBFILES
BBFILES := "${BBFILES} \
            ${LAYERDIR}/recipes-*/*/*.bb \
            ${LAYERDIR}/recipes-*/*/*.bbappend"


BBFILE_COLLECTIONS += "meta-tizen-common-demo"
BBFILE_PATTERN_meta-tizen-common-demo := "^${LAYERDIR}/"
BBFILE_PRIORITY_meta-tizen-common-demo = "8"
```

## meta-tizen/meta-tizen-common-share/conf/layer.conf
```bitbake
# We have a conf and classes directory, add to BBPATH
BBPATH .= ":${LAYERDIR}"

# We have a packages directory, add to BBFILES
BBFILES := "${BBFILES} \
            ${LAYERDIR}/recipes-*/*/*.bb \
            ${LAYERDIR}/recipes-*/*/*.bbappend"

BBFILE_COLLECTIONS += "meta-tizen-common-share"
BBFILE_PATTERN_meta-tizen-common-share := "^${LAYERDIR}/"
BBFILE_PRIORITY_meta-tizen-common-share = "8"
```
