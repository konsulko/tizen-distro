## meta-tizen/meta-tizen-ivi/conf/bblayers.conf.sample
```bitbake
# LAYER_CONF_VERSION is increased each time build/conf/bblayers.conf
# changes incompatibly
LCONF_VERSION = "5"

BBPATH = "${TOPDIR}"
BBFILES ?= ""

BBLAYERS ?= " \
  ##OEROOT##/meta \
  ##OEROOT##/meta-openembedded/meta-oe \
  ##OEROOT##/meta-openembedded/meta-multimedia \
  ##OEROOT##/meta-openembedded/meta-ruby \
  ##OEROOT##/meta-openembedded/meta-systemd \
  ##OEROOT##/meta-openembedded/meta-gnome \
  ##OEROOT##/meta-tizen/meta-tizen-adaptation/meta \
  ##OEROOT##/meta-tizen/meta-tizen-adaptation/meta-oe \
  ##OEROOT##/meta-tizen/meta-tizen-common-base \
  ##OEROOT##/meta-tizen/meta-tizen-common-share \
  ##OEROOT##/meta-tizen/meta-tizen-common-devtools \
  ##OEROOT##/meta-tizen/meta-tizen-common-demo \
  ##OEROOT##/meta-tizen/meta-tizen-ivi \
  "

BBLAYERS_NON_REMOVABLE ?= " \
  ##OEROOT##/meta \
  ##OEROOT##/meta-openembedded/meta-oe \
  ##OEROOT##/meta-openembedded/meta-multimedia \
  ##OEROOT##/meta-openembedded/meta-ruby \
  ##OEROOT##/meta-openembedded/meta-systemd \
  ##OEROOT##/meta-openembedded/meta-gnome \
  ##OEROOT##/meta-tizen/meta-tizen-adaptation-oe-core \
  ##OEROOT##/meta-tizen/meta-tizen-adaptation-meta-oe \
  ##OEROOT##/meta-tizen/meta-tizen-common-base \
  "
```

## meta-tizen/meta-tizen-ivi/conf/distro/tizen-ivi.conf
```bitbake
require conf/distro/tizen.conf
DISTRO = "tizen-ivi"

# Use weston from Tizen since it contains Tizen specific patches
WESTONSTARTUP = "weston-ivi"
IMAGECONFIG = "config-tizen-ivi"
TLMCONFIG = "tlm-config-ivi-singleseat"

DISTRO_FEATURES += "tizen-ivi"
```

## meta-tizen/meta-tizen-ivi/conf/layer.conf
```bitbake
DISTRO = "tizen-ivi"

# We have a conf and classes directory, add to BBPATH
BBPATH .= ":${LAYERDIR}"

# We have a packages directory, add to BBFILES
BBFILES := "${BBFILES} \
            ${LAYERDIR}/recipes-*/*/*.bb \
            ${LAYERDIR}/recipes-*/*/*.bbappend"


BBFILE_COLLECTIONS += "meta-tizen-ivi"
BBFILE_PATTERN_meta-tizen-ivi := "^${LAYERDIR}/"
BBFILE_PRIORITY_meta-tizen-ivi = "9"
```
